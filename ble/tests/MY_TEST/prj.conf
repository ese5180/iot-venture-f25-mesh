## CMakeLists.txt
```
cmake_minimum_required(VERSION 3.20.0)
find_package(Zephyr REQUIRED HINTS $ENV{ZEPHYR_BASE})
project(sum_unit_test)

target_sources(app PRIVATE src/sum_test.c)
```

## Kconfig
```
# menu "Unit test configuration"

# config TEST_FORCE_SUM_LOG
#     bool "Force Logger implementation in tests"
#     default y
#     select SUM_LOG      
#     select LOG          

# endmenu

# source "Kconfig.zephyr"
```

## prj.conf
```kconfig
<<<<<<< HEAD
CONFIG_ZTEST=y
CONFIG_ZTEST_ASSERT_VERBOSE=2

CONFIG_LOG=y
CONFIG_LOG_DEFAULT_LEVEL=3 
=======
CONFIG_ZTEST=y
CONFIG_ZTEST_ASSERT_VERBOSE=2

CONFIG_LOG=y
CONFIG_LOG_DEFAULT_LEVEL=3 
>>>>>>> haichao
```

## src/sum_test.c
```c
#include <zephyr/ztest.h>

ZTEST(sum_suite, test_dummy_always_pass)
{
    zassert_true(1 == 1, "This test should always pass");
}

ZTEST_SUITE(sum_suite, NULL, NULL, NULL, NULL, NULL);
```
