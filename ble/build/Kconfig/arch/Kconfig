## ble/build/Kconfig/arch/Kconfig
```kconfig
# Load Zephyr Arch Kconfig descriptions.
osource "D:/ESE5180/iot-venture-f25-mesh/zephyr/arch/rx/Kconfig"
osource "D:/ESE5180/iot-venture-f25-mesh/zephyr/arch/x86/Kconfig"
osource "D:/ESE5180/iot-venture-f25-mesh/zephyr/arch/xtensa/Kconfig"
osource "D:/ESE5180/iot-venture-f25-mesh/zephyr/arch/sparc/Kconfig"
osource "D:/ESE5180/iot-venture-f25-mesh/zephyr/arch/riscv/Kconfig"
osource "D:/ESE5180/iot-venture-f25-mesh/zephyr/arch/posix/Kconfig"
osource "D:/ESE5180/iot-venture-f25-mesh/zephyr/arch/mips/Kconfig"
osource "D:/ESE5180/iot-venture-f25-mesh/zephyr/arch/arm64/Kconfig"
osource "D:/ESE5180/iot-venture-f25-mesh/zephyr/arch/arm/Kconfig"
osource "D:/ESE5180/iot-venture-f25-mesh/zephyr/arch/arc/Kconfig"
```

## ble/build/Kconfig/boards/Kconfig.defconfig
```kconfig
# Load Zephyr board defconfig descriptions.
osource "D:/ESE5180/iot-venture-f25-mesh/zephyr/boards/native/native_sim/Kconfig.defconfig"
```

## ble/build/Kconfig/soc/Kconfig
```kconfig
# Load Zephyr SoC Kconfig descriptions.
osource "D:/ESE5180/iot-venture-f25-mesh/zephyr/soc/xlnx/zynqmp/Kconfig"
osource "D:/ESE5180/iot-venture-f25-mesh/zephyr/soc/xlnx/zynq7000/Kconfig"
osource "D:/ESE5180/iot-venture-f25-mesh/zephyr/soc/xlnx/versalnet/Kconfig"
osource "D:/ESE5180/iot-venture-f25-mesh/zephyr/soc/xlnx/versal2/Kconfig"
osource "D:/ESE5180/iot-venture-f25-mesh/zephyr/soc/xen/Kconfig"
osource "D:/ESE5180/iot-venture-f25-mesh/zephyr/soc/wch/ch32v/Kconfig"
osource "D:/ESE5180/iot-venture-f25-mesh/zephyr/soc/ti/simplelink/Kconfig"
osource "D:/ESE5180/iot-venture-f25-mesh/zephyr/soc/ti/mspm0/Kconfig"
osource "D:/ESE5180/iot-venture-f25-mesh/zephyr/soc/ti/lm3s6965/Kconfig"
osource "D:/ESE5180/iot-venture-f25-mesh/zephyr/soc/ti/k3/Kconfig"
osource "D:/ESE5180/iot-venture-f25-mesh/zephyr/soc/telink/tlsr/Kconfig"
osource "D:/ESE5180/iot-venture-f25-mesh/zephyr/soc/starfive/jh71xx/Kconfig"
osource "D:/ESE5180/iot-venture-f25-mesh/zephyr/soc/st/stm32/Kconfig"
osource "D:/ESE5180/iot-venture-f25-mesh/zephyr/soc/snps/qemu_arc/Kconfig"
osource "D:/ESE5180/iot-venture-f25-mesh/zephyr/soc/snps/nsim/arc_v/Kconfig"
osource "D:/ESE5180/iot-venture-f25-mesh/zephyr/soc/snps/nsim/arc_classic/Kconfig"
osource "D:/ESE5180/iot-venture-f25-mesh/zephyr/soc/snps/hsdk4xd/Kconfig"
osource "D:/ESE5180/iot-venture-f25-mesh/zephyr/soc/snps/hsdk/Kconfig"
osource "D:/ESE5180/iot-venture-f25-mesh/zephyr/soc/snps/emsk/Kconfig"
osource "D:/ESE5180/iot-venture-f25-mesh/zephyr/soc/snps/emsdp/Kconfig"
osource "D:/ESE5180/iot-venture-f25-mesh/zephyr/soc/snps/arc_iot/Kconfig"
osource "D:/ESE5180/iot-venture-f25-mesh/zephyr/soc/silabs/Kconfig"
osource "D:/ESE5180/iot-venture-f25-mesh/zephyr/soc/sifli/sf32/Kconfig"
osource "D:/ESE5180/iot-venture-f25-mesh/zephyr/soc/sifive/sifive_freedom/Kconfig"
osource "D:/ESE5180/iot-venture-f25-mesh/zephyr/soc/sensry/Kconfig"
osource "D:/ESE5180/iot-venture-f25-mesh/zephyr/soc/rockchip/Kconfig"
osource "D:/ESE5180/iot-venture-f25-mesh/zephyr/soc/renode/riscv_virtual/Kconfig"
osource "D:/ESE5180/iot-venture-f25-mesh/zephyr/soc/renode/cortex_r8_virtual/Kconfig"
osource "D:/ESE5180/iot-venture-f25-mesh/zephyr/soc/renesas/smartbond/Kconfig"
osource "D:/ESE5180/iot-venture-f25-mesh/zephyr/soc/renesas/rz/Kconfig"
osource "D:/ESE5180/iot-venture-f25-mesh/zephyr/soc/renesas/rx/Kconfig"
osource "D:/ESE5180/iot-venture-f25-mesh/zephyr/soc/renesas/rcar/Kconfig"
osource "D:/ESE5180/iot-venture-f25-mesh/zephyr/soc/renesas/ra/Kconfig"
osource "D:/ESE5180/iot-venture-f25-mesh/zephyr/soc/realtek/ec/Kconfig"
osource "D:/ESE5180/iot-venture-f25-mesh/zephyr/soc/raspberrypi/rpi_pico/Kconfig"
osource "D:/ESE5180/iot-venture-f25-mesh/zephyr/soc/quicklogic/eos_s3/Kconfig"
osource "D:/ESE5180/iot-venture-f25-mesh/zephyr/soc/qemu/virt_riscv/Kconfig"
osource "D:/ESE5180/iot-venture-f25-mesh/zephyr/soc/qemu/malta/Kconfig"
osource "D:/ESE5180/iot-venture-f25-mesh/zephyr/soc/openisa/rv32m1/Kconfig"
osource "D:/ESE5180/iot-venture-f25-mesh/zephyr/soc/openhwgroup/cva6/Kconfig"
osource "D:/ESE5180/iot-venture-f25-mesh/zephyr/soc/oct/osd32mp15x/Kconfig"
osource "D:/ESE5180/iot-venture-f25-mesh/zephyr/soc/nxp/s32/Kconfig"
osource "D:/ESE5180/iot-venture-f25-mesh/zephyr/soc/nxp/rw/Kconfig"
osource "D:/ESE5180/iot-venture-f25-mesh/zephyr/soc/nxp/mcx/Kconfig"
osource "D:/ESE5180/iot-venture-f25-mesh/zephyr/soc/nxp/lpc/Kconfig"
osource "D:/ESE5180/iot-venture-f25-mesh/zephyr/soc/nxp/layerscape/Kconfig"
osource "D:/ESE5180/iot-venture-f25-mesh/zephyr/soc/nxp/kinetis/Kconfig"
osource "D:/ESE5180/iot-venture-f25-mesh/zephyr/soc/nxp/imxrt/Kconfig"
osource "D:/ESE5180/iot-venture-f25-mesh/zephyr/soc/nxp/imx/Kconfig"
osource "D:/ESE5180/iot-venture-f25-mesh/zephyr/soc/nuvoton/numicro/Kconfig"
osource "D:/ESE5180/iot-venture-f25-mesh/zephyr/soc/nuvoton/numaker/Kconfig"
osource "D:/ESE5180/iot-venture-f25-mesh/zephyr/soc/nuvoton/npcx/Kconfig"
osource "D:/ESE5180/iot-venture-f25-mesh/zephyr/soc/nuvoton/npcm/Kconfig"
osource "D:/ESE5180/iot-venture-f25-mesh/zephyr/soc/nordic/Kconfig"
osource "D:/ESE5180/iot-venture-f25-mesh/zephyr/soc/neorv32/Kconfig"
osource "D:/ESE5180/iot-venture-f25-mesh/zephyr/soc/native/inf_clock/Kconfig"
osource "D:/ESE5180/iot-venture-f25-mesh/zephyr/soc/microchip/sam/Kconfig"
osource "D:/ESE5180/iot-venture-f25-mesh/zephyr/soc/microchip/sam/sama7/Kconfig"
osource "D:/ESE5180/iot-venture-f25-mesh/zephyr/soc/microchip/sam/sam_d5x_e5x/Kconfig"
osource "D:/ESE5180/iot-venture-f25-mesh/zephyr/soc/microchip/pic32c/pic32cz_ca/Kconfig"
osource "D:/ESE5180/iot-venture-f25-mesh/zephyr/soc/microchip/pic32c/pic32cx_sg/Kconfig"
osource "D:/ESE5180/iot-venture-f25-mesh/zephyr/soc/microchip/pic32c/pic32cm_jh/Kconfig"
osource "D:/ESE5180/iot-venture-f25-mesh/zephyr/soc/microchip/miv/Kconfig"
osource "D:/ESE5180/iot-venture-f25-mesh/zephyr/soc/microchip/mec/Kconfig"
osource "D:/ESE5180/iot-venture-f25-mesh/zephyr/soc/mediatek/mt8xxx/Kconfig"
osource "D:/ESE5180/iot-venture-f25-mesh/zephyr/soc/lowrisc/opentitan/Kconfig"
osource "D:/ESE5180/iot-venture-f25-mesh/zephyr/soc/litex/litex_vexriscv/Kconfig"
osource "D:/ESE5180/iot-venture-f25-mesh/zephyr/soc/ite/ec/Kconfig"
osource "D:/ESE5180/iot-venture-f25-mesh/zephyr/soc/intel/raptor_lake/Kconfig"
osource "D:/ESE5180/iot-venture-f25-mesh/zephyr/soc/intel/panther_lake/Kconfig"
osource "D:/ESE5180/iot-venture-f25-mesh/zephyr/soc/intel/lakemont/Kconfig"
osource "D:/ESE5180/iot-venture-f25-mesh/zephyr/soc/intel/intel_socfpga_std/Kconfig"
osource "D:/ESE5180/iot-venture-f25-mesh/zephyr/soc/intel/intel_socfpga/Kconfig"
osource "D:/ESE5180/iot-venture-f25-mesh/zephyr/soc/intel/intel_niosv/Kconfig"
osource "D:/ESE5180/iot-venture-f25-mesh/zephyr/soc/intel/intel_ish/Kconfig"
osource "D:/ESE5180/iot-venture-f25-mesh/zephyr/soc/intel/intel_adsp/Kconfig"
osource "D:/ESE5180/iot-venture-f25-mesh/zephyr/soc/intel/elkhart_lake/Kconfig"
osource "D:/ESE5180/iot-venture-f25-mesh/zephyr/soc/intel/atom/Kconfig"
osource "D:/ESE5180/iot-venture-f25-mesh/zephyr/soc/intel/apollo_lake/Kconfig"
osource "D:/ESE5180/iot-venture-f25-mesh/zephyr/soc/intel/alder_lake/Kconfig"
osource "D:/ESE5180/iot-venture-f25-mesh/zephyr/soc/infineon/edge/Kconfig"
osource "D:/ESE5180/iot-venture-f25-mesh/zephyr/soc/infineon/cat3/Kconfig"
osource "D:/ESE5180/iot-venture-f25-mesh/zephyr/soc/infineon/cat1c/Kconfig"
osource "D:/ESE5180/iot-venture-f25-mesh/zephyr/soc/infineon/cat1b/Kconfig"
osource "D:/ESE5180/iot-venture-f25-mesh/zephyr/soc/infineon/cat1a/Kconfig"
osource "D:/ESE5180/iot-venture-f25-mesh/zephyr/soc/gd/gd32/Kconfig"
osource "D:/ESE5180/iot-venture-f25-mesh/zephyr/soc/gaisler/leon3/Kconfig"
osource "D:/ESE5180/iot-venture-f25-mesh/zephyr/soc/gaisler/gr716a/Kconfig"
osource "D:/ESE5180/iot-venture-f25-mesh/zephyr/soc/espressif/Kconfig"
osource "D:/ESE5180/iot-venture-f25-mesh/zephyr/soc/ene/kb1200/Kconfig"
osource "D:/ESE5180/iot-venture-f25-mesh/zephyr/soc/ene/kb106x/Kconfig"
osource "D:/ESE5180/iot-venture-f25-mesh/zephyr/soc/egis/Kconfig"
osource "D:/ESE5180/iot-venture-f25-mesh/zephyr/soc/efinix/sapphire/Kconfig"
osource "D:/ESE5180/iot-venture-f25-mesh/zephyr/soc/cdns/xtensa_sample_controller/Kconfig"
osource "D:/ESE5180/iot-venture-f25-mesh/zephyr/soc/cdns/sample_controller32/Kconfig"
osource "D:/ESE5180/iot-venture-f25-mesh/zephyr/soc/cdns/dc233c/Kconfig"
osource "D:/ESE5180/iot-venture-f25-mesh/zephyr/soc/brcm/bcmvk/Kconfig"
osource "D:/ESE5180/iot-venture-f25-mesh/zephyr/soc/brcm/bcm2712/Kconfig"
osource "D:/ESE5180/iot-venture-f25-mesh/zephyr/soc/brcm/bcm2711/Kconfig"
osource "D:/ESE5180/iot-venture-f25-mesh/zephyr/soc/bflb/Kconfig"
osource "D:/ESE5180/iot-venture-f25-mesh/zephyr/soc/atmel/sam0/Kconfig"
osource "D:/ESE5180/iot-venture-f25-mesh/zephyr/soc/atmel/sam/Kconfig"
osource "D:/ESE5180/iot-venture-f25-mesh/zephyr/soc/aspeed/Kconfig"
osource "D:/ESE5180/iot-venture-f25-mesh/zephyr/soc/arm/Kconfig"
osource "D:/ESE5180/iot-venture-f25-mesh/zephyr/soc/arm/beetle/Kconfig"
osource "D:/ESE5180/iot-venture-f25-mesh/zephyr/soc/antmicro/myra/Kconfig"
osource "D:/ESE5180/iot-venture-f25-mesh/zephyr/soc/andestech/Kconfig"
osource "D:/ESE5180/iot-venture-f25-mesh/zephyr/soc/amd/acp_6_0/Kconfig"
osource "D:/ESE5180/iot-venture-f25-mesh/zephyr/soc/ambiq/Kconfig"
osource "D:/ESE5180/iot-venture-f25-mesh/zephyr/soc/aesc/Kconfig"
osource "D:/ESE5180/iot-venture-f25-mesh/zephyr/soc/adi/max32/Kconfig"
```

## ble/tests/test_bno055/testcase.yaml
```yaml
tests:
  bno055.ztest:
    platform_allow:
      - native_sim/native/64
    tags: bno055 sensor ztest
    harness: ztest
```

## ble/tests/test_sen0209/testcase.yaml
```yaml
tests:
  sen0209.ztest:
    platform_allow:
      - native_sim/native/64
    tags: sen0209 unit hardware
    harness: ztest
```
